## base_external/configs/aesd_qemu_defconfig
```kconfig
BR2_KERNEL_HEADERS_5_10=y
BR2_TARGET_GENERIC_ROOT_PASSWD="root"
BR2_ROOTFS_OVERLAY="../base_external/rootfs_overlay"
BR2_LINUX_KERNEL=y
BR2_PACKAGE_AESD_ASSIGNMENTS=y
BR2_PACKAGE_LDD=y
```

## base_external/package/aesdchardriver/Config.in
```kconfig
config BR2_PACKAGE_AESDCHARDRIVER
	bool "aesdchardriver"
	help
	  asesdchar_driver for Assignment 8
```

## base_external/package/ldd/Config.in
```kconfig
config BR2_PACKAGE_LDD
	bool "ldd"
	select BR2_LINUX_KERNEL
	help
	  kernel driver for assignment7
```
